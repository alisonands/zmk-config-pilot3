## config/boards/shields/pilot/Kconfig.defconfig
```kconfig
if SHIELD_PILOT_LEFT

config ZMK_KEYBOARD_NAME
    default "Pilot"

config ZMK_SPLIT_ROLE_CENTRAL
    default y

endif

if SHIELD_PILOT_LEFT || SHIELD_PILOT_RIGHT

config ZMK_SPLIT
    default y

endif
```

## config/boards/shields/pilot/Kconfig.shield
```kconfig
# Copyright (c) 2020 Pete Johanson
# SPDX-License-Identifier: MIT

config SHIELD_PILOT_LEFT
    def_bool $(shields_list_contains,pilot_left)

config SHIELD_PILOT_RIGHT
    def_bool $(shields_list_contains,pilot_right)
```

## config/west.yml
```yaml
manifest:
  remotes:
    - name: zmkfirmware
      url-base: https://github.com/zmkfirmware
    - name: alisonands # <-- new entry
      url-base: https://github.com/alisonands
    # Additional modules containing boards/shields/custom code can be listed here as well
    # See https://docs.zephyrproject.org/3.2.0/develop/west/manifest.html#projects
  projects:
    - name: zmk
      remote: zmkfirmware
      revision: main
      import: app/west.yml
    - name: zmk-config-pilot3 # <-- new entry
      remote: alisonands
      revision: main
  self:
    path: config
```
